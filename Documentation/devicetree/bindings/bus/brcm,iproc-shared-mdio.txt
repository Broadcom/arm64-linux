## Documentation/devicetree/bindings/bus/brcm,iproc-shared-mdio.txt
```
Broadcom iProc Shared MDIO Controller

Required properties:
- compatible:
    "brcm,iproc-shared-mdio" for shared MDIO controller.
- reg: specifies the base physical address and size of the registers
- reg-names: should be "mdio"
- #address-cells: must be 1.
- #size-cells: must be 0.

optional:
child nodes: Masters are represented as a child node of shared MDIO controller
and all the PHYs handled by this master are represented as its child node.

Master nodes properties are defined as-

Required properties:
- compatible: Used to match driver of this PHY.
- reg: MDIO master ID.
- #address-cells: must be 1.
- #size-cells: must be 0.

optional:
-brcm,phy-internal: if presents, PHYs are internal. Absence shows phy is
external.
-brcm,is-c45: if presents, Controller uses Clause-45 to issue MDIO transaction.
else Controller uses Clause-22 for transactions.

PHY nodes are represented as the child node of Master. Child nodes properties
are defined as-

Required properties:
-reg: phy id of attached PHY.

optional:
There could be additional properties required to configure the specific phy like
phy-mode in case of gpphy node below. These should be defined here and used by
respective drivers.

Example:
iproc_mdio: iproc_mdio@663f0000 {
	compatible = "brcm,iproc-shared-mdio";
	reg = <0x6602023c 0x14>;
	reg-names = "mdio";
	#address-cells = <1>;
	#size-cells = <0>;

	sata-master@6 {
		compatible = "brcm,iproc-ns2-sata-phy";
		reg = <0x6>;
		#address-cells = <1>;
		#size-cells = <0>;
		brcm,phy-internal;

		sata_phy0: sata-phy@1 {
			reg = <0x1>;
			#phy-cells = <0>;
		};

		sata_phy1: sata-phy@2 {
			reg = <0x2>;
			#phy-cells = <0>;
		};
	};

	eth-master@0 {
		compatible = "brcm,iproc-mdio-master-eth";
		reg = <0x0>;
		#address-cells = <1>;
		#size-cells = <0>;
		gphy0: eth-phy@10 {
			reg = <0x10>;
			phy-mode = "mii";
		};
	};
};
```

## Documentation/devicetree/bindings/firmware/qcom,scm.txt
```
QCOM Secure Channel Manager (SCM)

Qualcomm processors include an interface to communicate to the secure firmware.
This interface allows for clients to request different types of actions.  These
can include CPU power up/down, HDCP requests, loading of firmware, and other
assorted actions.

Required properties:
- compatible: must contain "qcom,scm"
- clocks: Should contain the core, iface, and bus clocks.
- clock-names: Must contain "core" for the core clock, "iface" for the interface
  clock and "bus" for the bus clock.

Example:

	firmware {
		compatible = "simple-bus";

		scm {
			compatible = "qcom,scm";
			clocks = <&gcc GCC_CE1_CLK> , <&gcc GCC_CE1_AXI_CLK>, <&gcc GCC_CE1_AHB_CLK>;
			clock-names = "core", "bus", "iface";
		};
	};
```

## Documentation/devicetree/bindings/iio/adc/brcm,iproc-static-adc.txt
```
* Broadcom's IPROC Static ADC controller

Required properties:

- compatible: Must be "brcm,iproc-static-adc"

- #address-cells: Specify the number of u32 entries needed in child nodes.
  Should set to 1.

- #size-cells: Specify number of u32 entries needed to specify child nodes size
  in reg property. Should set to 1.

- adc-syscon: Handler of syscon node defining physical base address of the
  controller and length of memory mapped region.

- #io-channel-cells = <1>; As ADC has multiple outputs
  refer to Documentation/devicetree/bindings/iio/iio-bindings.txt for details.

- clocks: Clock used for this block.

- clock-names: Clock name should be given as tsc_clk.

- interrupts: interrupt line number.

For example:

	ts_adc_syscon: ts_adc_syscon@180a6000 {
		compatible = "brcm,iproc-ts-adc-syscon","syscon";
		reg = <0x180a6000 0xc30>;
	};

	adc: adc@180a6000 {
		compatible = "brcm,iproc-static-adc";
		#address-cells = <1>;
		#size-cells = <1>;
		adc-syscon = <&ts_adc_syscon>;
		#io-channel-cells = <1>;
		io-channel-ranges;
		clocks = <&asiu_clks BCM_CYGNUS_ASIU_ADC_CLK>;
		clock-names = "tsc_clk";
		interrupts = <GIC_SPI 164 IRQ_TYPE_LEVEL_HIGH>;
		status = "disabled";
	};
```

## Documentation/devicetree/bindings/net/brcm,iproc-mdio-shared.txt
```
Broadcom Ethernet master for shared mdio controller

Required properties:
- compatible: must be "brcm,iproc-mdio-master-eth"
- reg: master id of Ethernet block
- address-cells: should be 1
- size-cells: should be 0

Sub-nodes:
  Each port's PHY should be represented as a sub-node.

Sub-nodes required properties:
- reg: the PHY number
- phy-mode: media type connecting the PHY and MAC.


Example:
	eth-master@0 {
		compatible = "brcm,iproc-mdio-master-eth";
		reg = <0x0>;
		#address-cells = <1>;
		#size-cells = <0>;
		gphy0: eth-phy@10 {
			reg = <0x10>;
			phy-mode = "mii";
		};
		status = "ok"
	};

For more info on ethernet phy binding, please,refer to:
Documentation/devicetree/bindings/net/phy.txt
Documentation/devicetree/bindings/net/ethernet.txt
```

## Documentation/devicetree/bindings/net/brcm,mdio-mux-iproc.txt
```
Properties for an MDIO bus mutiplexer found in Broadcom iProc based SoCs.

This MDIO bus multiplexer defines buses that could be internal as well as
external to SoCs and could accept MDIO transaction compatible to C-22 or
C-45 Clause. When Child bus is selected, one need to select these two
properties as well to generate desired MDIO trascation on appropriate bus.

Required properties in addition to the generic multiplexer properties:

MDIO multiplexer node:
- complatible: brcm,mdio-mux-iproc.

Child bus node:
-brcm,is-c45: Boolean property indicating PHYs attached to this bus supports
	      C-45 mdio transaction.

Every non-ethernet PHY requires a compatible so that it could be probed based
on this compatible string.

Additional information regarding generic multiplexer properties could be found
at- Documentation/devicetree/bindings/net/mdio-mux.txt


for example:
		mdio_mux_iproc: mdio_mux_iproc@6602023c {
			compatible = "brcm,mdio-mux-iproc";
			reg = <0x6602023c 0x14>;
			#address-cells = <1>;
			#size-cells = <0>;
			mdio-integrated-mux;

			mdio@0 {
				reg = <0x0>;
				#address-cells = <1>;
				#size-cells = <0>;

				pci_phy0: pci-phy@0 {
					compatible = "brcm,ns2-pcie-phy";
					reg = <0x0>;
					#phy-cells = <0>;
				};
			};

			mdio@7 {
				reg = <0x7>;
				#address-cells = <1>;
				#size-cells = <0>;

				pci_phy1: pci-phy@0 {
					compatible = "brcm,ns2-pcie-phy";
					reg = <0x0>;
					#phy-cells = <0>;
				};
			};
			mdio@10 {
				reg = <0x10>;
				#address-cells = <1>;
				#size-cells = <0>;

				gphy0: eth-phy@10 {
					reg = <0x10>;
				};
			};
		};
```

## Documentation/devicetree/bindings/phy/brcm,cygnus-usb-phy.txt
```
BROADCOM CYGNUS USB PHY

Required Properties:
- compatible:  brcm,cygnus-usb-phy
- reg : the register start address and length for crmu_usbphy_aon_ctrl,
  cdru usb phy control and reset registers, usb host idm registers,
  usb device idm registers.
- reg-names: a list of the names corresponding to the previous register
  ranges. Should contain "crmu-usbphy-aon-ctrl", "cdru-usbphy",
  "usb2h-idm", "usb2d-idm".
- address-cells: should be 1
- size-cells: should be 0

Sub-nodes:
  Each port's PHY should be represented as a sub-node.

Sub-nodes required properties:
- reg: the PHY number
- #phy-cells must be 1
  The node that uses the phy must provide 1 integer argument specifying
  port number.

Optional Properties:
- vbus-p#-supply : The regulator for vbus out control for the host
  functionality enabled ports.
- vbus-gpios: vbus gpio binding
  This is mandatory for port 2, as port 2 is used as dual role phy.
  Based on the vbus and id values device or host role is determined
  for phy 2.

- extcon: extcon phandle
  This is mandatory for port 2,  as port 2 is used as dual role phy.
  extcon should be phandle to external usb gpio module which provide
  device or host role notifications based on the ID and VBUS gpio's state.


Refer to phy/phy-bindings.txt for the generic PHY binding properties

NOTE: port 0 and port 1 are host only and port 2 is dual role port.

Example of phy :
	usbphy: phy@0301c028 {
		compatible = "brcm,cygnus-usb-phy";
		reg = <0x0301c028 0x4>,
		      <0x0301d1b4 0x5c>,
		      <0x18115000 0xa00>,
		      <0x18111000 0xa00>;
		reg-names = "crmu-usbphy-aon-ctrl", "cdru-usbphy",
			    "usb2h-idm", "usb2d-idm";
		#address-cells = <1>;
		#size-cells = <0>;

		usbphy0: usb-phy@0 {
			reg = <0>;
			#phy-cells = <1>;
		};

		usbphy1: usb-phy@1 {
			reg = <1>;
			#phy-cells = <1>;
		};

		usbphy2: usb-phy@2 {
			reg = <2>;
			#phy-cells = <1>;
			extcon = <&extcon_usb>;
		};
	};

	extcon_usb: extcon_usb {
		compatible = "linux,extcon-usb-gpio";
		vbus-gpio = <&gpio_asiu 121 0>;
		id-gpio = <&gpio_asiu 122 0>;
		status = "okay";
	};


Example of node using the phy:

	/* This nodes declares all three ports, port 0
	and port 1 are host and port 2 is device */

	ehci0: usb@18048000 {
		compatible = "generic-ehci";
		reg = <0x18048000 0x100>;
		interrupts = <GIC_SPI 72 IRQ_TYPE_LEVEL_HIGH>;
		phys = <&usbphy0 0 &usbphy1 1 &usbphy2 2>;
		phy-names = "usbp0","usbp1","usbp2";
		status = "okay";
	};

	/* This node declares port 2 phy
	and configures it for device */

	usbd_udc_dwc1: usbd_udc_dwc@1804c000 {
		compatible = "iproc-udc";
		reg = <0x1804c000 0x2000>;
		interrupts = <GIC_SPI 123 IRQ_TYPE_LEVEL_HIGH>;
		phys = <&usbphy2 2>;
		phy-names = "usbdrd";
	};
```

## Documentation/devicetree/bindings/phy/brcm,iproc-mdio.txt
```
Broadcom iProc MDC/MDIO interface

Required properties:
- compatible: Must be "brcm,iproc-mdio"
- reg: base address and length of the MDC/MDIO block

Example:
	mdio: mdio@18002000 {
		compatible = "brcm,iproc-mdio";
		reg = <0x18002000 0x8>;
	};
```

## Documentation/devicetree/bindings/phy/brcm,ns2-drd-phy.txt
```
BROADCOM NORTHSTAR2 USB2 (DUAL ROLE DEVICE) PHY

Required properties:
 - compatible: brcm,ns2-drd-phy
 - reg: offset and length of the NS2 PHY related registers.
   The below registers must be provided.
   icfgdrd_regs -for DRD ICFG configurations
   idmdrd_rst_ctrl - for IDM DRD reset
   crmu_usb2_ctrl - for core vdd, PHY and PHY PLL reset
   usb2h_strap_reg - for port over current polarity reversal
 - #phy-cells: Must be 0. No args required.
 - vbus-gpios: vbus gpio binding
 - id-gpios: id gpio binding

Refer to phy/phy-bindings.txt for the generic PHY binding properties

Example:
	gpio_g: gpio@660a0000 {
			compatible = "brcm,iproc-gpio";
			reg = <0x660a0000 0x50>;
			ngpios = <32>;
			#gpio-cells = <2>;
			gpio-controller;
			interrupt-controller;
			interrupts = <GIC_SPI 400 IRQ_TYPE_LEVEL_HIGH>;
			brcm,pinconf-func-off = <IPROC_PIN_OFF_DRIVE_STRENGTH>;
	};

	usbdrd_phy: phy@66000960 {
			#phy-cells = <0>;
			compatible = "brcm,ns2-drd-phy";
			reg = <0x66000960 0x24>,
			      <0x67012800 0x4>,
			      <0x6501d148 0x4>,
			      <0x664d0700 0x4>;
			id-gpios = <&gpio_g 30 0>;
			vbus-gpios = <&gpio_g 31 0>;
	};
```

## Documentation/devicetree/bindings/soc/bcm/brcm,iproc-idm.txt
```
Broadcom iProc Interconnect Device Management (IDM) device

The Broadcom iProc IDM device allows control and monitoring of ASIC internal
bus transactions. Most importantly, it can be configured to detect bus
transaction timeout. In such case, critical information such as transaction
address that caused the error, bus master ID of the transaction that caused
the error, and etc., are made available from the IDM device.

-------------------------------------------------------------------------------

Required properties for IDM device node:
- compatible: must be "brcm,iproc-idm"
- reg: base address and length of the IDM register space
- interrupt: IDM interrupt number
- brcm,iproc-idm-bus: IDM bus string

Optional properties for IDM device node:
- brcm,iproc-idm-elog: phandle to the device node of the IDM logging device

-------------------------------------------------------------------------------

Required properties for IDM error logging device node:
- compatible: must be "brcm,iproc-idm-elog";
- reg: base address and length of reserved memory location where IDM error
  events can be saved

-------------------------------------------------------------------------------

Example:

idm {
	idm-elog {
		compatible = "brcm,iproc-idm-elog";
		reg = <0x8f221000 0x1000>;
	};

	idm-mhb-paxc-axi {
		compatible = "brcm,iproc-idm";
		reg = <0x60406900 0x200>;
		interrupt = <GIC_SPI 516 IRQ_TYPE_LEVEL_HIGH>;
		brcm,iproc-idm-bus = "idm-mhb-paxc-axi";
		brcm,iproc-idm-elog = <&idm-elog>;
	};
};
```

## Documentation/devicetree/bindings/thermal/brcm,sr-thermal.txt
```
* Broadcom Stingray Thermal

This binding describes thermal sensors that is part of Stingray SoCs.

Required properties:
- compatible : Must be "brcm,sr-thermal"
- reg : memory where tmon data will be available.
- brcm,tmon-mask: A one cell bit mask of valid TMON sources.
                  Each bit represents single TMON source.

Example:
	tmons {
		compatible = "simple-bus";
		#address-cells = <1>;
		#size-cells = <1>;
		ranges = <0x0 0x0 0x8f100000 0x100>;

		tmon: thermal@0 {
			compatible = "brcm,sr-thermal";
			reg = <0 0x40>;
			brcm,tmon-mask = <0x3f>;
		};
	};
```

## Documentation/devicetree/bindings/usb/brcm,iproc-snps-udc.txt
```
Broadcom IPROC USB Device controller.

The device node is used for UDCs integrated into Broadcom's
iProc family of SoCs'. The UDC is based on Synopsys Designware
Cores AHB Subsystem Device Controller.

Required properties:
 - compatible: should be "brcm,iproc-snps-udc"
 - reg: Offset and length of UDC register set
 - interrupts: description of interrupt line
 - phys: phandle to phy node.
 - extcon: phandle to the extcon device. This is optional and
   not required for those that don't require extcon support.
   Extcon support will be required if the UDC is connected to
   a Dual Role Device Phy that supports both Host and Device
   mode based on the external cable.

Example:
	udc_dwc: usb@664e0000 {
		compatible = "brcm,iproc-snps-udc";
		reg = <0x664e0000 0x2000>;
		interrupts = <GIC_SPI 424 IRQ_TYPE_LEVEL_HIGH>;
		phys = <&usbdrd_phy>;
		extcon = <&usbdrd_phy>";
```

## Documentation/devicetree/bindings/usb/snps,dw-ahb-udc.txt
```
Synopsys USB Device controller.

The device node is used for Synopsys Designware Cores AHB
Subsystem Device Controller (UDC).

Required properties:
 - compatible: should be "snps,dw-ahbudc"
 - reg: Offset and length of UDC register set
 - interrupts: description of interrupt line
 - phys: phandle to phy node.
 - phy-names: name of phy node. Must be usb2drd.
 - extcon: phandle to the extcon device

Example:

	usbdrd_phy: phy@6501c000 {
		#phy-cells = <0>;
		compatible = "brcm,ns2-drd-phy";
		reg = <0x66000000 0x1000>,
	}

	udc_dwc: usb@664e0000 {
		compatible = "snps,dw-ahb-udc";
		reg = <0x664e0000 0x2000>;
		interrupts = <GIC_SPI 424 IRQ_TYPE_LEVEL_HIGH>;
		phys = <&usbdrd_phy>;
		phy-names = "usb2drd";
		extcon = <&usbdrd_phy>";
	};
```

## arch/arm/mach-qcom/Kconfig
```kconfig
menuconfig ARCH_QCOM
	bool "Qualcomm Support"
	depends on ARCH_MULTI_V7
	select ARCH_SUPPORTS_BIG_ENDIAN
	select ARM_GIC
	select ARM_AMBA
	select PINCTRL
	select QCOM_SCM if SMP
	help
	  Support for Qualcomm's devicetree based systems.

if ARCH_QCOM

config ARCH_QCOM_A_FAMILY
	bool "Support a-family chipsets (msm8660, msm8960, apq8064)"
	default y
	select CLKSRC_QCOM
	help
	  Select this option if you want to support a-family platforms.

	  A-family includes all Snapdragon S1/S2/S3/S4 chips before 2013,
	  up to the MSM8x60 and APQ8064 SoCs.

	  B-family includes all Snapdragon 2xx/4xx/6xx/8xx models starting
	  in 2013 with the MSM8x74 SoC.

endif
```
