## drivers/clk/samsung/Kconfig
```kconfig
config COMMON_CLK_SAMSUNG
	bool
	select COMMON_CLK

# ARM SoCs:
config S3C2410_COMMON_CLK
	bool
	select COMMON_CLK_SAMSUNG
	help
	  Build the s3c2410 clock driver based on the common clock framework.

config S3C2410_COMMON_DCLK
	bool
	select COMMON_CLK_SAMSUNG
	select REGMAP_MMIO
	help
	  Temporary symbol to build the dclk driver based on the common clock
	  framework.

config S3C2412_COMMON_CLK
	bool
	select COMMON_CLK_SAMSUNG

config S3C2443_COMMON_CLK
	bool
	select COMMON_CLK_SAMSUNG

# ARM64 SoCs (e.g. Exynos5433, Exynos7):
config EXYNOS_ARM64_COMMON_CLK
	def_bool ARCH_EXYNOS
	depends on ARM64 || COMPILE_TEST
	select COMMON_CLK_SAMSUNG
```
